## conf/layer.conf
```bitbake
# We have a conf and classes directory, add to BBPATH
BBPATH .= ":${LAYERDIR}"

# We have a packages directory, add to BBFILES
BBFILES += "${LAYERDIR}/recipes-*/*/*.bb"
BBFILES += "${LAYERDIR}/recipes-*/*/*.bbappend"

BBFILE_COLLECTIONS += "stinger96bsp"
BBFILE_PATTERN_stinger96bsp = "^${LAYERDIR}/"
BBFILE_PRIORITY_stinger96bsp = "5"

LAYERSERIES_COMPAT_stinger96bsp = "zeus dunfell master gatesgarth"
```

## conf/machine/include/stinger96-common.inc
```bitbake
DFAULTTUNE ?= "cortexa7thf-neon-vfpv4"
SOC_FAMILY ?= "stm32mp1"

ARM_INSTRUCTION_SET = "thumb"

require conf/machine/include/tune-cortexa7.inc
require conf/machine/include/soc-family.inc

MACHINE_FEATURES ?= "apm ext2 keyboard screen serial usbgadget usbhost"

SERIAL_CONSOLE = "115200 ttySTM1"

# U-Boot bootloader
UBOOT_MAKE_TARGET := "all"
UBOOT_BINARY := "u-boot.img"
SPL_BINARY := "spl/u-boot-spl.stm32"
#UBOOT_ENV_SUFFIX = "scr"
#UBOOT_ENV = "boot"

PREFERRED_PROVIDER_virtual/bootloader = "u-boot"
PREFERRED_PROVIDER_u-boot = "u-boot"
PREFERRED_PROVIDER_u-boot-native = "u-boot"
PREFERRED_PROVIDER_u-boot-fw-utils = "u-boot-fw-utils"
PREFERRED_PROVIDER_u-boot-fw-utils-native = "u-boot-fw-utils-native"
PREFERRED_VERSION_u-boot = "2018.11%"
PREFERRED_VERSION_u-boot-native = "2018.11%"
PREFERRED_VERSION_u-boot-fw-utils = "2018.11%"
PREFERRED_VERSION_u-boot-fw-utils-native = "2018.11%"

# Linux kernel
KERNEL_IMAGETYPE     =  "uImage"
KERNEL_ALT_IMAGETYPE =  " Image "
KERNEL_ALT_IMAGETYPE =+ " vmlinux "
KERNEL_ALT_IMAGETYPE =+ " zImage "

PREFERRED_PROVIDER_virtual/kernel = "linux-mainline"
PREFERRED_VERSION_linux-yocto = "5.9%"

# Ship kernel modules
MACHINE_ESSENTIAL_EXTRA_RDEPENDS += " kernel-modules kernel-devicetree u-boot-default-env "
```

## conf/machine/iotbox.conf
```bitbake
#@TYPE: Machine
#@NAME: IoTBox board
#@SOC:  ST STM32MP1
#@DESCRIPTION: Machine configuration for Shiratech IoTBox board

require conf/machine/include/stinger96-common.inc

# U-Boot bootloader
UBOOT_MACHINE = "iotbox_defconfig"
UBOOT_EXTLINUX = "1"
UBOOT_EXTLINUX_FDT = "../stm32mp157a-iot-box.dtb"

# Linux kernel
KERNEL_DEVICETREE = " \
	stm32mp157a-iot-box.dtb \
	"

# Ship kernel modules
MACHINE_ESSENTIAL_EXTRA_RDEPENDS += " \
	cypress-firmware-bcm43xx-bt-patch-bcm4345c0 \
	cypress-firmware-bcm43xx-fmac-fw-bcm43455-1mw-sdio \
	cypress-firmware-bcm43xx-fmac-nvram-bcm43455-1mw-sdio \
	"
```

## conf/machine/stinger96.conf
```bitbake
#@TYPE: Machine
#@NAME: Stinger96 board
#@SOC:  ST STM32MP1
#@DESCRIPTION: Machine configuration for Shiratech Stinger96 board

require conf/machine/include/stinger96-common.inc

# U-Boot bootloader
UBOOT_MACHINE = "stinger96_defconfig"
UBOOT_EXTLINUX = "1"
UBOOT_EXTLINUX_FDT = "../stm32mp157a-stinger96.dtb"

# Linux kernel
KERNEL_DEVICETREE = " \
	stm32mp157a-stinger96.dtb \
	"
```

## wic/sd.wks
```
part fsbl1 --source rawcopy --sourceparams="file=u-boot-spl.stm32" --part-name "fsbl1" --ondisk mmcblk --part-type 0x8301 --align 1 --size 256k
part fsbl2 --source rawcopy --sourceparams="file=u-boot-spl.stm32" --part-name "fsbl2" --ondisk mmcblk --part-type 0x8301 --align 1 --size 256k
part ssbl --source rawcopy --sourceparams="file=u-boot.img" --part-name "ssbl" --ondisk mmcblk --part-type 0x8301 --align 1 --size 2M
part / --source rootfs --ondisk mmcblk0 --fstype=ext4 --label rootfs --part-name "rootfs" --align 4096 --use-uuid --active

bootloader --ptable gpt
```
